## google-iot/main/Kconfig.projbuild
```kconfig
menu "Example Configuration"

    config ESP_WIFI_SSID
        string "NetComm 2161-EXT"
        default "NetComm 2161-EXT"
        help
            SSID (network name) for the example to connect to.

    config ESP_WIFI_PASSWORD
        string "qudaceruqi"
        default "qudaceruqi"
        help
            WiFi password (WPA or WPA2) for the example to use.

    config ESP_MAXIMUM_RETRY
        int "Maximum retry"
        default 5
        help
            Set the Maximum retry to avoid station reconnecting to the AP unlimited when the AP is really inexistent.
endmenu
```
